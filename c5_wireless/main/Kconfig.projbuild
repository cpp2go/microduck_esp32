## c5_wireless/main/Kconfig.projbuild
```kconfig
menu "Microduck C5 → P4 UART"

    config MICRODUCK_C5_UART_NUM
        int "UART port"
        range 0 2
        default 1

    config MICRODUCK_C5_UART_BAUD
        int "Baud rate"
        default 921600

    config MICRODUCK_C5_UART_TX_GPIO
        int "TX GPIO (C5 TX → P4 RX)"
        range 0 30
        default 10

    config MICRODUCK_C5_UART_RX_GPIO
        int "RX GPIO (C5 RX ← P4 TX)"
        range 0 30
        default 11

    config MICRODUCK_C5_CMD_HZ
        int "Default command publish rate (Hz)"
        range 1 50
        default 20

endmenu
```

## c5_wireless/sdkconfig.defaults
```kconfig
CONFIG_IDF_TARGET="esp32c5"
CONFIG_ESP_CONSOLE_UART_DEFAULT=y
CONFIG_COMPILER_OPTIMIZATION_PERF=y
```

## components/cmd_link/Kconfig
```kconfig
menu "Microduck P4 ← C5 command link"

    choice MICRODUCK_CMD_TRANSPORT
        prompt "Transport to ESP32-C5"
        default MICRODUCK_CMD_SDIO_ENABLE

        config MICRODUCK_CMD_SDIO_ENABLE
            bool "SDIO (esp_hosted peer-data) — production"
            help
                P4 is esp_hosted host; C5 runs coprocessor firmware with
                SDIO slave. Remote command frames use MICRODUCK_MSG_ID_CMD.

        config MICRODUCK_CMD_UART_ENABLE
            bool "UART (bench / no coprocessor)"
            help
                Wire-cross UART only when SDIO is unavailable. Do not use with
                esp_hosted SDIO on the same link.
    endchoice

    menu "UART bench options"
        depends on MICRODUCK_CMD_UART_ENABLE

        config MICRODUCK_CMD_UART_NUM
            int "UART port number"
            range 0 2
            default 1

        config MICRODUCK_CMD_UART_BAUD
            int "UART baud rate"
            default 921600

        config MICRODUCK_CMD_UART_TX_GPIO
            int "UART TX GPIO (P4 TX → C5 RX)"
            range 0 55
            default 17

        config MICRODUCK_CMD_UART_RX_GPIO
            int "UART RX GPIO (P4 RX ← C5 TX)"
            range 0 55
            default 18
    endmenu

endmenu
```

## components/imu/Kconfig
```kconfig
menu "Microduck IMU (ICM-42688 SPI)"

    config MICRODUCK_IMU_ENABLE
        bool "Probe and use ICM-42688 for policy observations"
        default y
        help
            When enabled, imu::Init() brings up a TDK ICM-42688 (or ICM-42688-P)
            on SPI. Gyro + projected gravity fill obs[0:6] like pollen-robotics
            microduck duck-control ImuData. If init fails, those channels stay
            synthetic and the 50 Hz loop still runs.

    config MICRODUCK_IMU_SPI_HOST
        int "SPI host (2 = SPI2_HOST on ESP32-P4)"
        range 1 3
        default 2
        depends on MICRODUCK_IMU_ENABLE

    config MICRODUCK_IMU_SPI_SCLK_GPIO
        int "SPI SCLK GPIO"
        range 0 55
        default 9
        depends on MICRODUCK_IMU_ENABLE

    config MICRODUCK_IMU_SPI_MOSI_GPIO
        int "SPI MOSI (SDA) GPIO"
        range 0 55
        default 8
        depends on MICRODUCK_IMU_ENABLE

    config MICRODUCK_IMU_SPI_MISO_GPIO
        int "SPI MISO (SDO) GPIO"
        range 0 55
        default 10
        depends on MICRODUCK_IMU_ENABLE

    config MICRODUCK_IMU_SPI_CS_GPIO
        int "SPI CS GPIO"
        range 0 55
        default 11
        depends on MICRODUCK_IMU_ENABLE

    config MICRODUCK_IMU_SPI_HZ
        int "SPI clock Hz"
        range 100000 24000000
        default 8000000
        depends on MICRODUCK_IMU_ENABLE
        help
            ICM-42688 allows up to 24 MHz in SPI mode 0/3; 8 MHz is a safe default
            for short carrier wiring.

endmenu
```

## components/servo_bus/Kconfig
```kconfig
menu "Microduck servo bus"

    config MICRODUCK_SERVO_ENABLE
        bool "Drive servos and fill proprioception obs"
        default y

    choice MICRODUCK_SERVO_BACKEND
        prompt "Servo bus protocol"
        default MICRODUCK_SERVO_BACKEND_FEETECH
        depends on MICRODUCK_SERVO_ENABLE
        help
            Feetech HD1910/STS uses FT-SCS SyncRead/Write @ 1 Mbps.
            Unitree S288 uses 20/26-byte CRC frames @ 6 Mbps (no SyncRead).

        config MICRODUCK_SERVO_BACKEND_FEETECH
            bool "Feetech 1910 (STS / HD1910M)"

        config MICRODUCK_SERVO_BACKEND_UNITREE_S288
            bool "Unitree S288 / J288"
    endchoice

    config MICRODUCK_SERVO_UART_NUM
        int "UART port"
        range 0 2
        default 2
        depends on MICRODUCK_SERVO_ENABLE

    config MICRODUCK_SERVO_UART_BAUD
        int "Baud rate"
        default 1000000 if MICRODUCK_SERVO_BACKEND_FEETECH
        default 6000000 if MICRODUCK_SERVO_BACKEND_UNITREE_S288
        depends on MICRODUCK_SERVO_ENABLE
        help
            Feetech factory default 1 Mbps. Unitree S288 protocol is fixed at 6 Mbps.

    config MICRODUCK_SERVO_TX_GPIO
        int "UART TX GPIO"
        range -1 55
        default 20
        depends on MICRODUCK_SERVO_ENABLE

    config MICRODUCK_SERVO_RX_GPIO
        int "UART RX GPIO (tie to TX for half-duplex TTL if single-wire)"
        range -1 55
        default 19
        depends on MICRODUCK_SERVO_ENABLE

    config MICRODUCK_SERVO_DIR_GPIO
        int "Half-duplex DE/RE GPIO (-1 = no direction pin)"
        range -1 55
        default -1
        depends on MICRODUCK_SERVO_ENABLE

    config MICRODUCK_SERVO_POSITION_KP
        int "Feetech Position P gain (Temporary KP @50 / P_Coeff @21)"
        default 32
        depends on MICRODUCK_SERVO_ENABLE && MICRODUCK_SERVO_BACKEND_FEETECH
        help
            Feetech P coefficient range 0..254.

    config MICRODUCK_SERVO_S288_KP_MILLI
        int "Unitree S288 Kp × 1000 (output N·m/rad)"
        default 10000
        depends on MICRODUCK_SERVO_ENABLE && MICRODUCK_SERVO_BACKEND_UNITREE_S288
        help
            Output-shaft stiffness. 10000 = Kp 10.0 (see Unitree digital_servo demo).

    config MICRODUCK_SERVO_S288_KD_MILLI
        int "Unitree S288 Kd × 1000 (output N·m/(rad/s))"
        default 1000
        depends on MICRODUCK_SERVO_ENABLE && MICRODUCK_SERVO_BACKEND_UNITREE_S288
        help
            Output-shaft damping. 1000 = Kd 1.0.

    config MICRODUCK_SERVO_ACTION_SCALE
        int "Action scale × 1000 (robotd default 0.9 = 900)"
        default 900
        depends on MICRODUCK_SERVO_ENABLE

    config MICRODUCK_SERVO_HEAD_LOWPASS
        int "Head joint low-pass alpha × 1000 (robotd default 0.5)"
        default 500
        depends on MICRODUCK_SERVO_ENABLE

    config MICRODUCK_SERVO_LEG_LOWPASS
        int "Leg joint low-pass alpha × 1000 (robotd default 0.7)"
        default 700
        depends on MICRODUCK_SERVO_ENABLE

    config MICRODUCK_SERVO_FAIL_LIMIT
        int "Disable torque after this many consecutive read failures"
        default 10
        depends on MICRODUCK_SERVO_ENABLE

endmenu
```

## components/tof/Kconfig
```kconfig
menu "Microduck ToF (distance / obstacle)"

    config MICRODUCK_TOF_ENABLE
        bool "Enable ToF frame bus + obstacle gate"
        default y
        help
            8×8 depth API matching pollen-robotics/microduck tofd (VL53L8CX).

    config MICRODUCK_TOF_GATE_IN_LOOP
        bool "Apply obstacle gate to cmd twist in 50 Hz loop"
        default y
        depends on MICRODUCK_TOF_ENABLE
        help
            Scale/zero twist.x when ahead < REACT_M / STOP_M (autod-style).

    config MICRODUCK_TOF_ULD
        bool "Compile ST VL53L8CX Ultra Lite Driver (full ranging)"
        default n
        depends on MICRODUCK_TOF_ENABLE
        help
            Vendors the original microduck tof/vendor VL53L8CX ULD (~550 KB
            firmware blob in .rodata) with an ESP-IDF I2C platform. Enable when
            a VL53L8CX is wired and flash budget allows. When off, synthetic/
            inject remains the backend (API surface identical).

    config MICRODUCK_TOF_I2C_PROBE
        bool "Probe / open VL53 on I2C"
        default y
        depends on MICRODUCK_TOF_ENABLE
        help
            Soft presence check always. With MICRODUCK_TOF_ULD, also uploads
            firmware and starts 8×8 ranging at 15 Hz.

    config MICRODUCK_TOF_I2C_PORT
        int "ToF I2C port"
        range 0 1
        default 0
        depends on MICRODUCK_TOF_I2C_PROBE

    config MICRODUCK_TOF_I2C_SDA_GPIO
        int "ToF I2C SDA GPIO"
        range 0 55
        default 7
        depends on MICRODUCK_TOF_I2C_PROBE

    config MICRODUCK_TOF_I2C_SCL_GPIO
        int "ToF I2C SCL GPIO"
        range 0 55
        default 8
        depends on MICRODUCK_TOF_I2C_PROBE

    config MICRODUCK_TOF_I2C_ADDR
        hex "ToF 7-bit I2C address"
        default 0x29
        depends on MICRODUCK_TOF_I2C_PROBE
        help
            VL53L8CX default address is 0x29.

    config MICRODUCK_TOF_RANGE_HZ
        int "ULD ranging frequency (Hz)"
        range 1 15
        default 15
        depends on MICRODUCK_TOF_ULD

endmenu
```

## components/vision/Kconfig
```kconfig
menu "Microduck vision"

    config MICRODUCK_VISION_ENABLE
        bool "Enable vision frame bus"
        default y
        help
            Provides vision_grab / detect stubs. Default backend is synthetic
            (no CSI). Full mediad (V4L2 + WebRTC + YOLO) is Linux-only.

    config MICRODUCK_VISION_WIDTH
        int "Synthetic / capture width"
        range 32 640
        default 160
        depends on MICRODUCK_VISION_ENABLE

    config MICRODUCK_VISION_HEIGHT
        int "Synthetic / capture height"
        range 32 480
        default 120
        depends on MICRODUCK_VISION_ENABLE

    config MICRODUCK_VISION_CSI_HOOK
        bool "Compile CSI camera hook stubs (not wired)"
        default n
        depends on MICRODUCK_VISION_ENABLE
        help
            Placeholder symbols for a future ESP-IDF MIPI-CSI / DVP driver.
            Does not capture frames yet — document blocker in docs.

endmenu
```

## components/voice/Kconfig
```kconfig
menu "Microduck voice control (ES8311 mic)"

    config MICRODUCK_VOICE_ENABLE
        bool "Enable keyword / intent voice control"
        default y
        depends on MICRODUCK_SOUND_ENABLE
        help
            VAD + 8-band Goertzel templates over ES8311 mic. Not full ASR.
            Shell: voice listen | inject <stop|go|sit|stand|quack> | status

    config MICRODUCK_VOICE_AUTOSTART
        bool "Start listen task at boot"
        default n
        depends on MICRODUCK_VOICE_ENABLE

    config MICRODUCK_VOICE_WINDOW_MS
        int "Utterance capture window (ms)"
        range 200 1500
        default 450
        depends on MICRODUCK_VOICE_ENABLE

    config MICRODUCK_VOICE_VAD_PEAK
        int "VAD peak threshold (int16 abs)"
        range 500 20000
        default 2500
        depends on MICRODUCK_VOICE_ENABLE

    config MICRODUCK_VOICE_DEBOUNCE_MS
        int "Debounce after a hit (ms)"
        range 100 3000
        default 800
        depends on MICRODUCK_VOICE_ENABLE

    config MICRODUCK_VOICE_GO_VX
        int "GO intent forward twist ×1000"
        range 0 1000
        default 250
        depends on MICRODUCK_VOICE_ENABLE
        help
            Written into cmd_bus twist.x when intent=go (0.250 m/s default).

endmenu
```
